## Kconfig
```kconfig
menu "Simple REST Interface"

    config NANO_REST_DOMAIN
        string
        prompt "Nano Server Domain"
        default "yapraiwallet.space"
        help
            IP/URL for the Nano Server

    config NANO_REST_PATH
        string
        prompt "Nano Server Path"
        default "/api"
        help
            Nano Server Path

    config NANO_REST_PORT
        int
        prompt "Nano Server Port"
        default 5523
        help
            Nano Server Port

    config NANO_REST_RECEIVE_TIMEOUT
        int
        prompt "Receive Timeout Duration"
        default 5
        help
            The amount of seconds to wait for a server response.

    config NANO_REST_RECEIVE_BLOCK_SIZE
        int
        prompt "Caching increment size"
        default 512;
        help
            A larger number may take up more memory than necessary. A smaller
            will require more realloc and unnecessary fragmentation.
endmenu
```
